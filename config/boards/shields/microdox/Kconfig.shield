## config/boards/shields/microdox/Kconfig.shield
```kconfig
config SHIELD_MICRODOX_V2_LEFT
    def_bool $(shields_list_contains,microdox_v2_left)

config SHIELD_MICRODOX_V2_RIGHT
    def_bool $(shields_list_contains,microdox_v2_right)
```

## config/boards/shields/satpad/Kconfig.defconfig
```kconfig
# Copyright (c) 2022 The ZMK Contributors
# SPDX-License-Identifier: MIT

if SHIELD_SATPAD_DONGLE

config ZMK_KEYBOARD_NAME
    default "SatPad"

config ZMK_SPLIT_BLE_ROLE_CENTRAL
    default y

endif

if SHIELD_SATPAD || SHIELD_SATPAD_DONGLE

config ZMK_SPLIT
    default y

endif
```

## config/boards/shields/satpad/Kconfig.shield
```kconfig
# Copyright (c) 2022 The ZMK Contributors
# SPDX-License-Identifier: MIT

config SHIELD_SATPAD_DONGLE
	def_bool $(shields_list_contains,satpad_dongle)

config SHIELD_SATPAD
	def_bool $(shields_list_contains,satpad)
```
